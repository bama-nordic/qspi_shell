## CMakeLists.txt
```
#
# Copyright (c) 2022 Nordic Semiconductor ASA
#
# SPDX-License-Identifier: LicenseRef-Nordic-5-Clause
#

cmake_minimum_required(VERSION 3.13.1)

find_package(Zephyr REQUIRED HINTS $ENV{ZEPHYR_BASE})
project(qspi_shell)

target_compile_definitions_ifndef(
    SPI_IF
    app
    PRIVATE
    QSPI_IF
)

target_sources(app PRIVATE src/rpu_hw_if.c)
target_sources(app PRIVATE src/qspi_main.c)
target_sources_ifndef(SPI_IF app PRIVATE src/qspi_if.c)
target_sources_ifdef(SPI_IF app PRIVATE src/spi_if.c)
target_sources(app PRIVATE src/device.c)
```

## Kconfig.bk
```
DT_COMPAT_NORDIC_NRF7002_QSPI := nordic,nrf7002-qspi
DT_COMPAT_NORDIC_NRF7002_SPI := nordic,nrf7002-spi

config NRF700X_ON_QSPI
	def_bool $(dt_compat_enabled,$(DT_COMPAT_NORDIC_NRF7002_QSPI))
	select NRFX_QSPI

config NRF700X_ON_SPI
	def_bool $(dt_compat_enabled,$(DT_COMPAT_NORDIC_NRF7002_SPI))
	select SPI
```

## prj.conf
```kconfig
CONFIG_FLASH=y
#CONFIG_QSPI=y
CONFIG_SPI=y
CONFIG_HEAP_MEM_POOL_SIZE=80000

CONFIG_POSIX_API=y
CONFIG_CBPRINTF_FP_SUPPORT=y



# GPIO
CONFIG_GPIO=y


# Shell
CONFIG_SHELL=y
```

## src/device.c
```c
/*
 * Copyright (c) 2022 Nordic Semiconductor ASA
 *
 * SPDX-License-Identifier: LicenseRef-Nordic-5-Clause
 */

/**
 * @brief File containing QSPI device specific definitions for the
 * Zephyr OS layer of the Wi-Fi driver.
 */

#include <zephyr.h>
#include <sys/printk.h>
#include <drivers/gpio.h>
#include <stdio.h>
#include <string.h>

#include "qspi_if.h"
#include "spi_if.h"

struct qspi_config config;

#ifdef QSPI_IF
struct qspi_dev qspi = {
	.init = qspi_init,
	.read = qspi_read,
	.write = qspi_write,
	.hl_read = qspi_hl_read,
};
#else
struct qspi_dev spim = {
	.init = spim_init,
	.read = spim_read,
	.write = spim_write,
	.hl_read = spim_hl_read,
};
#endif

struct qspi_config *qspi_defconfig(void)
{

	memset(&config, 0, sizeof(struct qspi_config));

#if defined(QSPI_IF)
	config.addrmode = NRF_QSPI_ADDRMODE_24BIT;
	config.RDC4IO = 0xA0;
	config.easydma = true;
	config.quad_spi = true;
#endif
	config.addrmask = 0x800000; /* set bit23 (incr. addr mode) */

	config.freq = 8; /* 8Mhz */

	config.test_name = "QSPI TEST";
	config.test_hlread = false;
	config.test_iteration = 0;

	config.qspi_slave_latency = 0;

	if (config.freq > 8) /* 16Mhz */
		config.qspi_slave_latency = 1;

	config.encryption = config.CMD_CNONCE = false;

#ifdef QSPI_IF
	/*For #Bit 6 Enable below: i.e ALL Ones for QSPI Key*/
	memset(&config.p_cfg.key, 0xff, sizeof(config.p_cfg.key));

	config.p_cfg.nonce[0] = 0x16181648;
	config.p_cfg.nonce[1] = 0x0;
	config.p_cfg.nonce[2] = 0x1;

#endif /*QSPI_IF*/

	return &config;
}

struct qspi_dev *qspi_dev()
{
#ifdef QSPI_IF
	return &qspi;
#else
	return &spim;
#endif
}
```

## src/qspi_if.h
```c
/*
 * Copyright (c) 2022 Nordic Semiconductor ASA
 *
 * SPDX-License-Identifier: LicenseRef-Nordic-5-Clause
 */

/**
 * @brief Header containing QSPI device interface specific declarations for the
 * Zephyr OS layer of the Wi-Fi driver.
 */

#ifndef __QSPI_IF_H__
#define __QSPI_IF_H__

#include <zephyr/drivers/gpio.h>
#ifdef CONFIG_NRFX_QSPI
#include <nrfx_qspi.h>
#endif

#define RPU_WAKEUP_NOW BIT(0) /* WAKEUP RPU - RW */
#define RPU_AWAKE_BIT BIT(1) /* RPU AWAKE FROM SLEEP - RO */
#define RPU_READY_BIT BIT(2) /* RPU IS READY - RO*/

struct qspi_config {
#ifdef CONFIG_NRFX_QSPI
	nrf_qspi_addrmode_t addrmode;
	nrf_qspi_readoc_t readoc;
	nrf_qspi_writeoc_t writeoc;
	nrf_qspi_frequency_t sckfreq;
#endif
	unsigned int freq;
	unsigned int spimfreq;
	unsigned char RDC4IO;
	bool easydma;
	bool single_op;
	bool quad_spi;
	bool encryption;
	bool CMD_CNONCE;
	bool enc_enabled;
	struct k_sem lock;
	unsigned int addrmask;
	unsigned char qspi_slave_latency;
#ifdef CONFIG_NRFX_QSPI
	nrf_qspi_encryption_t p_cfg;
#endif /*CONFIG_NRFX_QSPI*/
	int test_hlread;
	char *test_name;
	int test_start;
	int test_end;
	int test_iterations;
	int test_timediff_read;
	int test_timediff_write;
	int test_status;
	int test_iteration;
};
struct qspi_dev {
	int (*deinit)(void);
	void *config;
	int (*init)(struct qspi_config *config);
	int (*write)(unsigned int addr, const void *data, int len);
	int (*read)(unsigned int addr, void *data, int len);
	int (*hl_read)(unsigned int addr, void *data, int len);
};

int qspi_cmd_wakeup_rpu(const struct device *dev, uint8_t data);

int qspi_init(struct qspi_config *config);

int qspi_write(unsigned int addr, const void *data, int len);

int qspi_read(unsigned int addr, void *data, int len);

int qspi_hl_read(unsigned int addr, void *data, int len);

int qspi_deinit(void);

struct qspi_config *qspi_defconfig(void);

struct qspi_dev *qspi_dev(void);

int qspi_cmd_sleep_rpu(const struct device *dev);

void get_sleep_stats(uint32_t addr, uint32_t *buff, uint32_t wrd_len);

extern struct device qspi_perip;

int qspi_validate_rpu_wake_writecmd(const struct device *dev);
int qspi_cmd_wakeup_rpu(const struct device *dev, uint8_t data);
int qspi_wait_while_firmware_awake(const struct device *dev);
int qspi_wait_while_rpu_awake(const struct device *dev);

int qspi_RDSR1(const struct device *dev, uint8_t *rdsr1);
int qspi_RDSR2(const struct device *dev, uint8_t *rdsr2);
int qspi_WRSR2(const struct device *dev, const uint8_t wrsr2);

#ifdef CONFIG_NRF700x_LOW_POWER_MODE
int func_rpu_sleep(void);
int func_rpu_wake(void);
int func_rpu_sleep_status(void);
#endif /* CONFIG_NRF700x_LOW_POWER_MODE */
#endif /* __QSPI_IF_H__ */
```

## src/qspi_main.c
```c
/*
 * Copyright (c) 2022 Nordic Semiconductor ASA
 *
 * SPDX-License-Identifier: LicenseRef-Nordic-5-Clause
 */

/**
 * @brief File containing RPU utils that can be invoked from shell.
 */

#include <stdio.h>
#include <stdlib.h>
#include <string.h>
#include <sys/time.h>

#include <zephyr/shell/shell.h>
#include <zephyr/logging/log.h>

#include "rpu_hw_if.h"

LOG_MODULE_DECLARE(wifi_nrf, CONFIG_WIFI_LOG_LEVEL);

#define SW_VER "1.6"

enum {
	SHELL_OK = 0,
	SHELL_FAIL = 1
};

// Convert to shell return values
static inline int shell_ret(int ret)
{
	if (ret)
		return SHELL_FAIL;
	else
		return SHELL_OK;
}


void print_memmap(const struct shell *shell)
{
	for (int i = 0; i < NUM_MEM_BLOCKS; i++) {
		shell_print(shell, " %-14s : 0x%06x - 0x%06x (%05d words)\n",
					blk_name[i],
					rpu_7002_memmap[i][0],
					rpu_7002_memmap[i][1],
					1 + ((rpu_7002_memmap[i][1] - rpu_7002_memmap[i][0]) >> 2)
					);
	}
}

static int cmd_write_wrd(const struct shell *shell, size_t argc, char **argv)
{
	uint32_t val;
	uint32_t addr;

	addr = strtoul(argv[1], NULL, 0);
	val = strtoul(argv[2], NULL, 0);

	return shell_ret(rpu_write(addr, &val, 4));
}

static int cmd_write_blk(const struct shell *shell, size_t argc, char **argv)
{
	uint32_t pattern;
	uint32_t addr;
	uint32_t num_words;
	uint32_t offset;
	uint32_t *buff;
	int i;

	addr = strtoul(argv[1], NULL, 0);
	pattern = strtoul(argv[2], NULL, 0);
	offset = strtoul(argv[3], NULL, 0);
	num_words = strtoul(argv[4], NULL, 0);

	if (num_words > 2000) {
		shell_print(shell,
			    "Presently supporting block read/write only upto 2000 32-bit words");
		return SHELL_FAIL;
	}

	buff = (uint32_t *)k_malloc(num_words * 4);
	for (i = 0; i < num_words; i++) {
		buff[i] = pattern + i * offset;
	}

	if (!rpu_write(addr, buff, num_words * 4))
		return SHELL_FAIL;

	k_free(buff);

	return SHELL_OK;
}

static int cmd_read_wrd(const struct shell *shell, size_t argc, char **argv)
{
	uint32_t val;
	uint32_t addr;

	addr = strtoul(argv[1], NULL, 0);
	if (rpu_read(addr, &val, 4))
		return SHELL_FAIL;

	shell_print(shell, "0x%08x\n", val);
	return SHELL_OK;
}

static int cmd_read_blk(const struct shell *shell, size_t argc, char **argv)
{
	uint32_t *buff;
	uint32_t addr;
	uint32_t num_words;
	uint32_t rem;
	int i;

	addr = strtoul(argv[1], NULL, 0);
	num_words = strtoul(argv[2], NULL, 0);

	if (num_words > 2000) {
		shell_print(shell,
			    "Presently supporting block read/write only upto 2000 32-bit words");
		return SHELL_FAIL;
	}

	buff = (uint32_t *)k_malloc(num_words * 4);

	if (rpu_read(addr, buff, num_words * 4))
		return SHELL_FAIL;

	for (i = 0; i < num_words; i += 4) {
		rem = num_words - i;
		switch (rem) {
		case 1:
			shell_print(shell, "%08x", buff[i]);
			break;
		case 2:
			shell_print(shell, "%08x %08x", buff[i], buff[i + 1]);
			break;
		case 3:
			shell_print(shell, "%08x %08x %08x", buff[i], buff[i + 1], buff[i + 2]);
			break;
		default:
			shell_print(shell, "%08x %08x %08x %08x", buff[i], buff[i + 1], buff[i + 2],
				    buff[i + 3]);
			break;
		}
	}

	k_free(buff);
	return SHELL_OK;
}

static int cmd_memtest(const struct shell *shell, size_t argc, char **argv)
{
	/* $write_blk 0xc0000 0xdeadbeef 16 */
	uint32_t pattern;
	uint32_t addr;
	uint32_t num_words;
	uint32_t offset;
	uint32_t *buff, *rxbuff;
	int i;

	addr = strtoul(argv[1], NULL, 0);
	pattern = strtoul(argv[2], NULL, 0);
	offset = strtoul(argv[3], NULL, 0);
	num_words = strtoul(argv[4], NULL, 0);

	buff = (uint32_t *)k_malloc(2000 * 4);
	rxbuff = (uint32_t *)k_malloc(2000 * 4);

	int32_t rem_words = num_words;
	uint32_t test_chunk, chunk_no = 0;

	while (rem_words > 0) {
		test_chunk = (rem_words < 2000) ? rem_words : 2000;

		for (i = 0; i < test_chunk; i++) {
			buff[i] = pattern + (i + chunk_no * 2000) * offset;
		}

		if (rpu_write(addr, buff, test_chunk * 4) ||
			rpu_read(addr, rxbuff, test_chunk * 4)) {
			goto err;
		}

		if (memcmp(buff, rxbuff, test_chunk * 4) != 0) {
			goto err;
		}
		rem_words -= 2000;
		chunk_no++;
	}
	shell_print(shell, "memtest PASSED");
	k_free(rxbuff);
	k_free(buff);

	return SHELL_OK;
err:
	shell_print(shell, "memtest failed");
	k_free(rxbuff);
	k_free(buff);
	return SHELL_FAIL;
}

static int cmd_sleep_stats(const struct shell *shell, size_t argc, char **argv)
{
	uint32_t addr;
	uint32_t wrd_len;
	uint32_t *buff;

	addr = strtoul(argv[1], NULL, 0);
	wrd_len = strtoul(argv[2], NULL, 0);

	buff = (uint32_t *)k_malloc(wrd_len * 4);

	rpu_get_sleep_stats(addr, buff, wrd_len);

	for (int i = 0; i < wrd_len; i++) {
		shell_print(shell, "0x%08x\n", buff[i]);
	}

	k_free(buff);
	return SHELL_OK;
}

static int cmd_gpio_config(const struct shell *shell, size_t argc, char **argv)
{
	return shell_ret(rpu_gpio_config());
}

static int cmd_pwron(const struct shell *shell, size_t argc, char **argv)
{
	return shell_ret(rpu_pwron());
}

static int cmd_qspi_config(const struct shell *shell, size_t argc, char **argv)
{
	uint32_t qspi_spim_freq_MHz;
	uint32_t qspi_spim_latency;
	uint32_t mem_block;

	qspi_spim_freq_MHz = strtoul(argv[1], NULL, 0);
	mem_block = strtoul(argv[2], NULL, 0);
	qspi_spim_latency = strtoul(argv[3], NULL, 0);

	return shell_ret(rpu_qspi_config(qspi_spim_freq_MHz, qspi_spim_latency, mem_block));
}

static int cmd_qspi_init(const struct shell *shell, size_t argc, char **argv)
{
	return shell_ret(rpu_qspi_init());
}

static int cmd_rpuwake(const struct shell *shell, size_t argc, char **argv)
{
	return shell_ret(rpu_wakeup());
}

static int cmd_wrsr2(const struct shell *shell, size_t argc, char **argv)
{
	return shell_ret(rpu_wrsr2(strtoul(argv[1], NULL, 0) & 0xff));
}

static int cmd_rdsr2(const struct shell *shell, size_t argc, char **argv)
{
	uint8_t val = rpu_rdsr2();

	shell_print(shell, "RDSR2 = 0x%x\n", val);

	return SHELL_OK;
}

static int cmd_rdsr1(const struct shell *shell, size_t argc, char **argv)
{
	uint8_t val = rpu_rdsr1();

	shell_print(shell, "RDSR1 = 0x%x\n", val);

	return SHELL_OK;
}

static int cmd_rpuclks_on(const struct shell *shell, size_t argc, char **argv)
{
	return shell_ret(rpu_clks_on());
}


void dummy_irq_handler(const struct device *dev, struct gpio_callback *cb, uint32_t pins)
{
	LOG_DBG("\n !!! IRQ Hit !!!!\n");
}

static int cmd_wifi_on(const struct shell *shell, size_t argc, char **argv)
{
	int ret;
	struct gpio_callback irq_callback_data;

	ret = rpu_enable();
	if (ret) {
		goto err;
	}

	ret = rpu_irq_config(&irq_callback_data, dummy_irq_handler);
	if (ret) {
		goto err;
	}

	return SHELL_OK;
err:
	return SHELL_FAIL;
}

static int cmd_wifi_off(const struct shell *shell, size_t argc, char **argv)
{
	return shell_ret(rpu_disable());
}

static int cmd_memmap(const struct shell *shell, size_t argc, char **argv)
{
	print_memmap(shell);
	return SHELL_OK;
}

static void cmd_help(const struct shell *shell, size_t argc, char **argv)
{
	shell_print(shell, "Supported commands....  ");
	shell_print(shell, "=========================  ");
	shell_print(shell, "uart:~$ nrf700x_shell read_wrd    <address> ");
	shell_print(shell, "         ex: $ nrf700x_shell read_wrd 0x0c0000");
	shell_print(shell, "  ");
	shell_print(shell, "uart:~$ nrf700x_shell write_wrd   <address> <data>");
	shell_print(shell, "         ex: $ nrf700x_shell write_wrd 0x0c0000 0xabcd1234");
	shell_print(shell, "  ");
	shell_print(shell, "uart:~$ nrf700x_shell read_blk    <address> <num_words>");
	shell_print(shell, "         ex: $ nrf700x_shell read_blk 0x0c0000 64");
	shell_print(shell, "         Note - num_words can be a maximum of 2000");
	shell_print(shell, "  ");
	shell_print(
		shell,
		"uart:~$ nrf700x_shell write_blk   <address> <start_pattern> <pattern_increment> <num_words>");
	shell_print(shell, "         ex: $ nrf700x_shell write_blk 0x0c0000 0xaaaa5555 0 64");
	shell_print(
		shell,
		"         This writes pattern 0xaaaa5555 to 64 locations starting from 0x0c0000");
	shell_print(shell, "         ex: $ nrf700x_shell write_blk 0x0c0000 0x0 1 64");
	shell_print(
		shell,
		"         This writes pattern 0x0, 0x1,0x2,0x3....etc to 64 locations starting from 0x0c0000");
	shell_print(shell, "         Note - num_words can be a maximum of 2000");
	shell_print(shell, "  ");
	shell_print(
		shell,
		"uart:~$ nrf700x_shell memtest   <address> <start_pattern> <pattern_increment> <num_words>");
	shell_print(shell, "         ex: $ nrf700x_shell memtest 0x0c0000 0xaaaa5555 0 64");
	shell_print(
		shell,
		"         This writes pattern 0xaaaa5555 to 64 locations starting from 0x0c0000,");
	shell_print(shell, "         reads them back and validates them");
	shell_print(shell, "  ");
	shell_print(shell, "uart:~$ nrf700x_shell wifi_on  ");
#ifdef QSPI_IF
	shell_print(shell, "         - Configures all gpio pins ");
	shell_print(
		shell,
		"         - Writes 1 to BUCKEN (P0.12), waits for 2ms and then writes 1 to IOVDD Control (P0.31) ");
	shell_print(shell, "         - Initializes qspi interface and wakes up RPU");
	shell_print(shell, "         - Enables all gated RPU clocks");
#else
	shell_print(shell, "         - Configures all gpio pins ");
	shell_print(
		shell,
		"         - Writes 1 to BUCKEN (P1.01), waits for 2ms and then writes 1 to IOVDD Control (P1.00) ");
	shell_print(shell, "         - Initializes qspi interface and wakes up RPU");
	shell_print(shell, "         - Enables all gated RPU clocks");
#endif
	shell_print(shell, "  ");
	shell_print(shell, "uart:~$ nrf700x_shell wifi_off ");
#ifdef QSPI_IF
	shell_print(
		shell,
		"         This writes 0 to IOVDD Control (P0.31) and then writes 0 to BUCKEN Control (P0.12)");
#else
	shell_print(
		shell,
		"         This writes 0 to IOVDD Control (P1.00) and then writes 0 to BUCKEN Control (P1.01)");
#endif
	shell_print(shell, "  ");
	shell_print(shell, "uart:~$ nrf700x_shell sleep_stats ");
	shell_print(shell,
		    "         This continuously does the RPU sleep/wake cycle and displays stats ");
	shell_print(shell, "  ");
	shell_print(shell, "uart:~$ nrf700x_shell gpio_config ");
#ifdef QSPI_IF
	shell_print(
		shell,
		"         Configures BUCKEN(P0.12) as o/p, IOVDD control (P0.31) as output and HOST_IRQ (P0.23) as input");
	shell_print(shell, "         and interruptible with a ISR hooked to it");
#else
	shell_print(
		shell,
		"         Configures BUCKEN(P1.01) as o/p, IOVDD control (P1.00) as output and HOST_IRQ (P1.09) as input");
	shell_print(shell, "         and interruptible with a ISR hooked to it");
#endif
	shell_print(shell, "  ");
	shell_print(shell, "uart:~$ nrf700x_shell qspi_init ");
	shell_print(shell, "         Initializes QSPI driver functions ");
	shell_print(shell, "  ");
	shell_print(shell, "uart:~$ nrf700x_shell pwron ");
	shell_print(shell, "         Sets BUCKEN=1, delay, IOVDD cntrl=1 ");
	shell_print(shell, "  ");
	shell_print(shell, "uart:~$ nrf700x_shell rpuwake ");
	shell_print(shell, "         Wakeup RPU: Write 0x1 to WRSR2 register");
	shell_print(shell, "  ");
	shell_print(shell, "uart:~$ nrf700x_shell rpuclks_on ");
	shell_print(
		shell,
		"         Enables all gated RPU clocks. Only SysBUS and PKTRAM will work w/o this setting enabled");
	shell_print(shell, "  ");
	shell_print(shell, "uart:~$ nrf700x_shell wrsr2 <val> ");
	shell_print(shell, "         writes <val> (0/1) to WRSR2 reg - takes LSByte of <val>");
	shell_print(shell, "  ");
	shell_print(shell, "uart:~$ nrf700x_shell rdsr1 ");
	shell_print(shell, "         Reads RDSR1 Register");
	shell_print(shell, "  ");
	shell_print(shell, "uart:~$ nrf700x_shell rdsr2 ");
	shell_print(shell, "         Reads RDSR2 Register");
	shell_print(shell, "  ");
	shell_print(shell, "uart:~$ nrf700x_shell trgirq ");
	shell_print(shell, "         Generates IRQ interrupt to host");
	shell_print(shell, "  ");
	shell_print(shell, "uart:~$ nrf700x_shell clrirq ");
	shell_print(shell, "         Clears host IRQ generated interrupt");
	shell_print(shell, "  ");
	shell_print(shell,
		    "uart:~$ nrf700x_shell config  <qspi/spi Freq> <mem_block_num> <read_latency>");
	shell_print(shell, "         QSPI/SPI clock freq in MHz : 4/8/16 etc");
	shell_print(shell, "         block num as per memmap (starting from 0) : 0-10");
	shell_print(shell, "         QSPI/SPIM read latency for the selected block : 0-255");
	shell_print(
		shell,
		"         NOTE: need to do a wifi_off and wifi_on for these changes to take effect");
	shell_print(shell, "  ");
	shell_print(shell, "uart:~$ nrf700x_shell ver ");
	shell_print(shell, "         Display SW version and other details of the hex file ");
	shell_print(shell, "  ");
	shell_print(shell, "uart:~$ nrf700x_shell help ");
	shell_print(shell, "         Lists all commands with usage example(s) ");
	shell_print(shell, "  ");
}

static int cmd_ver(const struct shell *shell, size_t argc, char **argv)
{
	shell_print(shell, "nrf700x_shell Version: %s", SW_VER);
#ifdef QSPI_IF
	shell_print(shell, "Build for QSPI interface on nRF7002 board");
#else
	shell_print(shell,
		    "Build for SPIM interface on nRF7002EK+nRF5340DK connected via arduino header");
#endif
	return SHELL_OK;
}

static int cmd_trgirq(const struct shell *shell, size_t argc, char **argv)
{
	int i;
	static const uint32_t irq_regs[][2] = {
		{0x400, 0x20000},
		{0x494, 0x80000000},
		{0x484, 0x7fff7bee}
	};

	shell_print(shell, "Asserting IRQ to HOST");

	for (i = 0; i < ARRAY_SIZE(irq_regs); i++) {
		if (rpu_write(irq_regs[i][0], (const uint32_t *) irq_regs[i][1], 4)) {
			return SHELL_FAIL;
		}
	}

	return SHELL_OK;
}

static int cmd_clrirq(const struct shell *shell, size_t argc, char **argv)
{
	shell_print(shell, "de-asserting IRQ to HOST");

	return shell_ret(rpu_write(0x488, (uint32_t *)0x80000000, 4));
}

/* Creating subcommands (level 1 command) array for command "demo". */
SHELL_STATIC_SUBCMD_SET_CREATE(
	sub_nrf700x_shell,
	SHELL_CMD(write_blk, NULL,
		  "Writes a block of words to Sheliak host memory via QSPI interface",
		  cmd_write_blk),
	SHELL_CMD(read_blk, NULL,
		  "Reads a block of words from Sheliak host memory via QSPI interface",
		  cmd_read_blk),
	SHELL_CMD(write_wrd, NULL, "Writes a word to Sheliak host memory via QSPI interface",
		  cmd_write_wrd),
	SHELL_CMD(read_wrd, NULL, "Reads a word from Sheliak host memory via QSPI interface",
		  cmd_read_wrd),
	SHELL_CMD(wifi_on, NULL, "BUCKEN-IOVDD power ON", cmd_wifi_on),
	SHELL_CMD(wifi_off, NULL, "BUCKEN-IOVDD power OFF", cmd_wifi_off),
	SHELL_CMD(sleep_stats, NULL, "Tests Sleep/Wakeup cycles", cmd_sleep_stats),
	SHELL_CMD(gpio_config, NULL, "Configure all GPIOs", cmd_gpio_config),
	SHELL_CMD(qspi_init, NULL, "Initialize QSPI driver functions", cmd_qspi_init),
	SHELL_CMD(pwron, NULL, "BUCKEN=1, delay, IOVDD=1", cmd_pwron),
	SHELL_CMD(rpuwake, NULL, "Wakeup RPU: Write 0x1 to WRSR2 reg", cmd_rpuwake),
	SHELL_CMD(rpuclks_on, NULL, "Enable all RPU gated clocks", cmd_rpuclks_on),
	SHELL_CMD(wrsr2, NULL, "Write to WRSR2 register", cmd_wrsr2),
	SHELL_CMD(rdsr1, NULL, "Read RDSR1 register", cmd_rdsr1),
	SHELL_CMD(rdsr2, NULL, "Read RDSR2 register", cmd_rdsr2),
	SHELL_CMD(trgirq, NULL, "Generates IRQ interrupt to HOST", cmd_trgirq),
	SHELL_CMD(clrirq, NULL, "Clears generated Host IRQ interrupt", cmd_clrirq),
	SHELL_CMD(config, NULL, "Runtime config of SCK, Freq and latency for QSPI/SPIM",
		  cmd_qspi_config),
	SHELL_CMD(memmap, NULL, "Gives the full memory map of the Sheliak chip", cmd_memmap),
	SHELL_CMD(memtest, NULL, "Writes, reads back and validates specified memory on Seliak chip",
		  cmd_memtest),
	SHELL_CMD(ver, NULL, "Display SW version of the hex file", cmd_ver),
	SHELL_CMD(help, NULL, "Help with all supported commmands", cmd_help), SHELL_SUBCMD_SET_END);

/* Creating root (level 0) command "nrf700x_shell" */
SHELL_CMD_REGISTER(nrf700x_shell, &sub_nrf700x_shell, "nrf700x_shell commands", NULL);
```

## src/rpu_hw_if.c
```c
/*
 * Copyright (c) 2022 Nordic Semiconductor ASA
 *
 * SPDX-License-Identifier: LicenseRef-Nordic-5-Clause
 */

/**
 * @brief File containing common functions for RPU hardware interaction
 * using QSPI and SPI that can be invoked by shell or the driver.
 */

#include <string.h>
#include <sys/time.h>

#include <zephyr/zephyr.h>
#include <zephyr/sys/printk.h>
#include <zephyr/devicetree.h>
#include <zephyr/dt-bindings/gpio/nordic-nrf-gpio.h>
#include <zephyr/logging/log.h>

#include "rpu_hw_if.h"
#include "qspi_if.h"
#include "spi_if.h"

LOG_MODULE_DECLARE(wifi_nrf, CONFIG_WIFI_LOG_LEVEL);

#define NRF7002_NODE DT_NODELABEL(nrf7002)

static const struct gpio_dt_spec host_irq_spec =
GPIO_DT_SPEC_GET(NRF7002_NODE, host_irq_gpios);

static const struct gpio_dt_spec iovdd_ctrl_spec =
GPIO_DT_SPEC_GET(NRF7002_NODE, iovdd_ctrl_gpios);

static const struct gpio_dt_spec bucken_spec =
GPIO_DT_SPEC_GET(NRF7002_NODE, bucken_gpios);

char blk_name[][15] = { "SysBus",   "ExtSysBus",	   "PBus",	   "PKTRAM",
			       "GRAM",	   "LMAC_ROM",	   "LMAC_RET_RAM", "LMAC_SRC_RAM",
			       "UMAC_ROM", "UMAC_RET_RAM", "UMAC_SRC_RAM" };

uint32_t rpu_7002_memmap[][3] = {
	{ 0x000000, 0x008FFF, 1 },
	{ 0x009000, 0x03FFFF, 2 },
	{ 0x040000, 0x07FFFF, 1 },
	{ 0x0C0000, 0x0F0FFF, 0 },
	{ 0x080000, 0x092000, 1 },
	{ 0x100000, 0x134000, 1 },
	{ 0x140000, 0x14C000, 1 },
	{ 0x180000, 0x190000, 1 },
	{ 0x200000, 0x261800, 1 },
	{ 0x280000, 0x2A4000, 1 },
	{ 0x300000, 0x338000, 1 }
};

static const struct qspi_dev *qdev;
static struct qspi_config *cfg;

static int validate_addr_blk(uint32_t start_addr,
							 uint32_t end_addr,
							 uint32_t block_no,
							 bool *hl_flag,
							 int *selected_blk)
{
	uint32_t *block_map = rpu_7002_memmap[block_no];

	if (((start_addr >= block_map[0]) && (start_addr <= block_map[1])) &&
	    ((end_addr >= block_map[0]) && (end_addr <= block_map[1]))) {
		if (block_no == PKTRAM) {
			*hl_flag = 0;
		}
		*selected_blk = block_no;
		return 0;
	}

	return -1;
}

static int rpu_validate_addr(uint32_t start_addr, uint32_t len, bool *hl_flag)
{
	int ret = 0, i;
	uint32_t end_addr;
	int selected_blk;

	end_addr = start_addr + len - 1;

	*hl_flag = 1;

	for (i = 0; i < NUM_MEM_BLOCKS; i++) {
		ret = validate_addr_blk(start_addr, end_addr, i, hl_flag, &selected_blk);
		if (!ret) {
			break;
		}
	}

	if (ret) {
		LOG_ERR("Address validation failed - pls check memmory map and re-try\n");
		return -1;
	}

	if ((selected_blk == LMAC_ROM) || (selected_blk == UMAC_ROM)) {
		LOG_ERR("Error: Cannot write to ROM blocks");
		return -1;
	}

	cfg->qspi_slave_latency = (*hl_flag) ? rpu_7002_memmap[selected_blk][2] : 0;

	return 0;
}

int rpu_irq_config(struct gpio_callback *irq_callback_data, void (*irq_handler)())
{
	int ret;

	ret = gpio_pin_configure_dt(&host_irq_spec, GPIO_INPUT);

	ret = gpio_pin_interrupt_configure_dt(&host_irq_spec,
			GPIO_INT_EDGE_TO_ACTIVE);

	gpio_init_callback(irq_callback_data,
			irq_handler,
			BIT(host_irq_spec.pin));

	gpio_add_callback(host_irq_spec.port, irq_callback_data);

	LOG_DBG("Finished Interrupt config\n\n");

	return 0;
}

int rpu_gpio_config(void)
{
	int ret;

	if (!device_is_ready(iovdd_ctrl_spec.port)) {
		return -ENODEV;
	}

	if (!device_is_ready(bucken_spec.port)) {
		return -ENODEV;
	}

	if (!device_is_ready(host_irq_spec.port)) {
		return -ENODEV;
	}

	ret = gpio_pin_configure_dt(&bucken_spec,
			GPIO_OUTPUT | NRF_GPIO_DS_ALT);

	ret = gpio_pin_configure_dt(&iovdd_ctrl_spec, GPIO_OUTPUT);

	LOG_DBG("GPIO configuration done...\n\n");

	return 0;
}

int rpu_pwron(void)
{
	gpio_pin_set_dt(&bucken_spec, 1);
#if SHELIAK_SOC
	k_msleep(SLEEP_TIME_MS);
	gpio_pin_set_dt(&iovdd_ctrl_spec, 1);
	k_msleep(SLEEP_TIME_MS);
	LOG_DBG("BUCKEN=1, IOVDD=1...\n");
#else
#endif

	return 0;
}

int rpu_qspi_init(void)
{
	qdev = qspi_dev();

	cfg = qspi_defconfig();

	qdev->init(cfg);

	LOG_INF("QSPI/SPIM freq = %d MHz\n", cfg->freq);
	LOG_INF("QSPI/SPIM latency = %d\n", cfg->qspi_slave_latency);

	return 0;
}

int rpu_qspi_config(uint32_t freq, uint32_t latency, uint32_t mem_block)
{
	struct qspi_config *cfg;

	/* Re-initialize cfg */
	cfg = qspi_defconfig();

	cfg->freq = freq;
	rpu_7002_memmap[mem_block][2] = mem_block;
	cfg->qspi_slave_latency = latency;

	qdev->init(cfg);

	LOG_INF("QSPIM freq = %d MHz\n", cfg->freq);
	LOG_INF("QSPIM latency = %d\n", cfg->qspi_slave_latency);

	return 0;
}

int rpu_read(unsigned int addr, void *data, int len)
{
	bool hl_flag;

	if (rpu_validate_addr(addr, len, &hl_flag)) {
		return -1;
	}

	if (hl_flag)
		return qdev->hl_read(addr, data, len);
	else
		return qdev->read(addr, data, len);
}

int rpu_write(unsigned int addr, const void *data, int len)
{
	bool hl_flag;

	if (rpu_validate_addr(addr, len, &hl_flag)) {
		return -1;
	}

	return qdev->write(addr, data, len);
}

int rpu_sleep(void)
{
#ifdef QSPI_IF
	return qspi_cmd_sleep_rpu(&qspi_perip);
#else
	return spim_cmd_sleep_rpu_fn();
#endif
}

int rpu_wakeup(void)
{
	rpu_wrsr2(1);
	rpu_rdsr2();
	rpu_rdsr1();

	return 0;
}

int rpu_sleep_status(void)
{
	return rpu_rdsr1();
}

void rpu_get_sleep_stats(uint32_t addr, uint32_t *buff, uint32_t wrd_len)
{
	rpu_wakeup();
	rpu_read(addr, buff, wrd_len * 4);
	rpu_sleep();
}

int rpu_wrsr2(uint8_t data)
{
#ifdef QSPI_IF
	qspi_cmd_wakeup_rpu(&qspi_perip, data);
#else
	spim_cmd_rpu_wakeup_fn(data);
#endif

	LOG_DBG("Written 0x%x to WRSR2\n", data);
	return 0;
}

int rpu_rdsr2(void)
{
#ifdef QSPI_IF
	return qspi_validate_rpu_wake_writecmd(&qspi_perip);
#else
	return spi_validate_rpu_wake_writecmd();
#endif
}

int rpu_rdsr1(void)
{
#ifdef QSPI_IF
	return qspi_wait_while_rpu_awake(&qspi_perip);
#else
	return spim_wait_while_rpu_awake();
#endif
}


int rpu_clks_on(void)
{
#if SHELIAK_SOC
	uint32_t rpu_clks = 0x100;
	/* Enable RPU Clocks */
	qdev->write(0x048C20, &rpu_clks, 4);
	LOG_DBG("RPU Clocks ON...\n");
#endif
	return 0;
}

int rpu_enable(void)
{
	rpu_gpio_config();
	rpu_pwron();
	rpu_qspi_init();
	/* WAR for EK boards to wait longer for RPU to be ready after
	 * powering it on.
	 */
	k_msleep(8);
	rpu_wakeup();
	rpu_clks_on();

	return 0;
}

int rpu_disable(void)
{
#if SHELIAK_SOC
	gpio_pin_set_dt(&iovdd_ctrl_spec, 0); /* IOVDD CNTRL = 0 */
	gpio_pin_set_dt(&bucken_spec, 0); /* BUCKEN = 0 */
#endif
	return 0;
}
```

## src/spi_if.c
```c
/*
 * Copyright (c) 2022 Nordic Semiconductor ASA
 *
 * SPDX-License-Identifier: LicenseRef-Nordic-5-Clause
 */

/**
 * @brief File containing SPI device interface specific definitions for the
 * Zephyr OS layer of the Wi-Fi driver.
 */

#include <drivers/spi.h>
#include <nrfx_spim.h>
#include <string.h>

#define LOG_DOMAIN "spi_nrfx_spim"
#define LOG_LEVEL CONFIG_SPI_LOG_LEVEL
#include <logging/log.h>
LOG_MODULE_REGISTER(spi_nrfx_spim);

#include "spi_context.h"
#include "qspi_if.h"
#include "spi_if.h"

struct qspi_config *spim_config;
struct spi_nrfx_data {
	struct spi_context ctx;
	const struct device *dev;
	size_t chunk_len;
	bool   busy;
#ifdef CONFIG_PM_DEVICE
	uint32_t pm_state;
#endif
#if (CONFIG_SPI_NRFX_RAM_BUFFER_SIZE > 0)
	uint8_t   buffer[CONFIG_SPI_NRFX_RAM_BUFFER_SIZE];
#endif
};

struct spi_nrfx_config {
	nrfx_spim_t	   spim;
	size_t		   max_chunk_len;
	uint32_t	   max_freq;
	nrfx_spim_config_t config;
};

static inline struct spi_nrfx_data *get_dev_data(const struct device *dev)
{
	return dev->data;
}

static inline const struct spi_nrfx_config *get_dev_config(const struct device *dev)
{
	return dev->config;
}

static inline nrf_spim_frequency_t get_nrf_spim_frequency(uint32_t frequency)
{
	/* Get the highest supported frequency not exceeding the requested one.
	 */
	if (frequency < 250000) {
		return NRF_SPIM_FREQ_125K;
	} else if (frequency < 500000) {
		return NRF_SPIM_FREQ_250K;
	} else if (frequency < 1000000) {
		return NRF_SPIM_FREQ_500K;
	} else if (frequency < 2000000) {
		return NRF_SPIM_FREQ_1M;
	} else if (frequency < 4000000) {
		return NRF_SPIM_FREQ_2M;
	} else if (frequency < 8000000) {
		return NRF_SPIM_FREQ_4M;
/* Only the devices with HS-SPI can use SPI clock higher than 8 MHz and
 * have SPIM_FREQUENCY_FREQUENCY_M32 defined in their own bitfields.h
 */
#if defined(SPIM_FREQUENCY_FREQUENCY_M32)
	} else if (frequency < 16000000) {
		return NRF_SPIM_FREQ_8M;
	} else if (frequency < 32000000) {
		return NRF_SPIM_FREQ_16M;
	} else {
		return NRF_SPIM_FREQ_32M;
#else
	} else {
		return NRF_SPIM_FREQ_8M;
#endif
	}
}

static inline nrf_spim_mode_t get_nrf_spim_mode(uint16_t operation)
{
	if (SPI_MODE_GET(operation) & SPI_MODE_CPOL) {
		if (SPI_MODE_GET(operation) & SPI_MODE_CPHA)
			return NRF_SPIM_MODE_3;
		else
			return NRF_SPIM_MODE_2;
	} else {
		if (SPI_MODE_GET(operation) & SPI_MODE_CPHA)
			return NRF_SPIM_MODE_1;
		else
			return NRF_SPIM_MODE_0;
	}
}

static inline nrf_spim_bit_order_t get_nrf_spim_bit_order(uint16_t operation)
{
	if (operation & SPI_TRANSFER_LSB)
		return NRF_SPIM_BIT_ORDER_LSB_FIRST;
	else
		return NRF_SPIM_BIT_ORDER_MSB_FIRST;
}

static int configure(const struct device *dev,
		     const struct spi_config *spi_cfg)
{
	struct spi_context *ctx = &get_dev_data(dev)->ctx;
	const nrfx_spim_t *spim = &get_dev_config(dev)->spim;
	nrf_spim_frequency_t freq;

	if (spi_context_configured(ctx, spi_cfg))
		/* Already configured. No need to do it again. */
		return 0;

	if (SPI_OP_MODE_GET(spi_cfg->operation) != SPI_OP_MODE_MASTER) {
		LOG_ERR("Slave mode is not supported on %s",
			    dev->name);
		return -EINVAL;
	}

	if (spi_cfg->operation & SPI_MODE_LOOP) {
		LOG_ERR("Loopback mode is not supported");
		return -EINVAL;
	}

	if ((spi_cfg->operation & SPI_LINES_MASK) != SPI_LINES_SINGLE) {
		LOG_ERR("Only single line mode is supported");
		return -EINVAL;
	}

	if (SPI_WORD_SIZE_GET(spi_cfg->operation) != 8) {
		LOG_ERR("Word sizes other than 8 bits are not supported");
		return -EINVAL;
	}

	if (spi_cfg->frequency < 125000) {
		LOG_ERR("Frequencies lower than 125 kHz are not supported");
		return -EINVAL;
	}

	ctx->config = spi_cfg;
	spi_context_cs_configure(ctx);

	/* Limit the frequency to that supported by the SPIM instance */
	freq = get_nrf_spim_frequency(MIN(spi_cfg->frequency,
					  get_dev_config(dev)->max_freq));

	nrf_spim_configure(spim->p_reg,
			   get_nrf_spim_mode(spi_cfg->operation),
			   get_nrf_spim_bit_order(spi_cfg->operation));

	nrf_spim_frequency_set(spim->p_reg, get_nrf_spim_frequency(spim_config->spimfreq));

	return 0;
}

static void transfer_next_chunk(const struct device *dev)
{
	struct spi_nrfx_data *dev_data = get_dev_data(dev);
	const struct spi_nrfx_config *dev_config = get_dev_config(dev);
	struct spi_context *ctx = &dev_data->ctx;
	int error = 0;

	size_t chunk_len = spi_context_max_continuous_chunk(ctx);

	if (chunk_len > 0) {
		nrfx_spim_xfer_desc_t xfer;
		nrfx_err_t result;
		const uint8_t *tx_buf = ctx->tx_buf;
#if (CONFIG_SPI_NRFX_RAM_BUFFER_SIZE > 0)
		if (spi_context_tx_buf_on(ctx) && !nrfx_is_in_ram(tx_buf)) {
			if (chunk_len > sizeof(dev_data->buffer))
				chunk_len = sizeof(dev_data->buffer);

			memcpy(dev_data->buffer, tx_buf, chunk_len);
			tx_buf = dev_data->buffer;
		}
#endif
		if (chunk_len > dev_config->max_chunk_len)
			chunk_len = dev_config->max_chunk_len;

		dev_data->chunk_len = chunk_len;

		xfer.p_tx_buffer = tx_buf;
		xfer.tx_length   = spi_context_tx_buf_on(ctx) ? chunk_len : 0;
		xfer.p_rx_buffer = ctx->rx_buf;
		xfer.rx_length   = spi_context_rx_buf_on(ctx) ? chunk_len : 0;

		/* This SPIM driver is only used by the NRF52832 if
		 * SOC_NRF52832_ALLOW_SPIM_DESPITE_PAN_58 is enabled
		 */
		if (IS_ENABLED(CONFIG_SOC_NRF52832) &&
		   (xfer.rx_length == 1 && xfer.tx_length <= 1)) {
			LOG_WRN("Transaction aborted since it would trigger nRF52832 PAN 58");
			error = -EIO;
		}

		if (!error) {
			result = nrfx_spim_xfer(&dev_config->spim, &xfer, 0);

			if (result == NRFX_SUCCESS)
				return;

			error = -EIO;
		}
	}

	spi_context_cs_control(ctx, false);

	LOG_DBG("Transaction finished with status %d", error);

	spi_context_complete(ctx, error);
	dev_data->busy = false;
}

static int transceive(const struct device *dev,
		      const struct spi_config *spi_cfg,
		      const struct spi_buf_set *tx_bufs,
		      const struct spi_buf_set *rx_bufs,
		      bool asynchronous,
		      struct k_poll_signal *signal)
{
	struct spi_nrfx_data *dev_data = get_dev_data(dev);
	int error;

	spi_context_lock(&dev_data->ctx, asynchronous, signal, spi_cfg);

	error = configure(dev, spi_cfg);

	if (error == 0) {
		dev_data->busy = true;

		spi_context_buffers_setup(&dev_data->ctx, tx_bufs, rx_bufs, 1);
		spi_context_cs_control(&dev_data->ctx, true);

		transfer_next_chunk(dev);

		error = spi_context_wait_for_completion(&dev_data->ctx);
	}

	spi_context_release(&dev_data->ctx, error);

	return error;
}

static int spi_nrfx_transceive(const struct device *dev,
			       const struct spi_config *spi_cfg,
			       const struct spi_buf_set *tx_bufs,
			       const struct spi_buf_set *rx_bufs)
{
	return transceive(dev, spi_cfg, tx_bufs, rx_bufs, false, NULL);
}

#ifdef CONFIG_SPI_ASYNC
static int spi_nrfx_transceive_async(const struct device *dev,
				     const struct spi_config *spi_cfg,
				     const struct spi_buf_set *tx_bufs,
				     const struct spi_buf_set *rx_bufs,
				     struct k_poll_signal *async)
{
	return transceive(dev, spi_cfg, tx_bufs, rx_bufs, true, async);
}
#endif /* CONFIG_SPI_ASYNC */

static int spi_nrfx_release(const struct device *dev,
			    const struct spi_config *spi_cfg)
{
	struct spi_nrfx_data *dev_data = get_dev_data(dev);

	if (!spi_context_configured(&dev_data->ctx, spi_cfg))
		return -EINVAL;

	if (dev_data->busy)
		return -EBUSY;

	spi_context_unlock_unconditionally(&dev_data->ctx);

	return 0;
}

static const struct spi_driver_api spi_nrfx_driver_api = {
	.transceive = spi_nrfx_transceive,
#ifdef CONFIG_SPI_ASYNC
	.transceive_async = spi_nrfx_transceive_async,
#endif
	.release = spi_nrfx_release,
};


static void event_handler(const nrfx_spim_evt_t *p_event, void *p_context)
{
	struct spi_nrfx_data *dev_data = p_context;

	if (p_event->type == NRFX_SPIM_EVENT_DONE) {
		spi_context_update_tx(&dev_data->ctx, 1, dev_data->chunk_len);
		spi_context_update_rx(&dev_data->ctx, 1, dev_data->chunk_len);

		transfer_next_chunk(dev_data->dev);
	}
}

static int init_spim(const struct device *dev)
{
	struct spi_nrfx_data *data = get_dev_data(dev);
	nrfx_err_t result;

	data->dev = dev;

	/* This sets only default values of frequency, mode and bit order.
	 * The proper ones are set in configure() when a transfer is started.
	 */
	result = nrfx_spim_init(&get_dev_config(dev)->spim,
				&get_dev_config(dev)->config,
				event_handler,
				data);
	if (result != NRFX_SUCCESS) {
		LOG_ERR("Failed to initialize device: %s", dev->name);
		return -EBUSY;
	}

#ifdef CONFIG_PM_DEVICE
	data->pm_state = PM_DEVICE_STATE_ACTIVE;
	get_dev_data(dev)->pm_state = PM_DEVICE_STATE_ACTIVE;
#endif

	return 0;
}

#ifdef CONFIG_PM_DEVICE
static int spim_nrfx_pm_control(const struct device *dev,
				uint32_t ctrl_command,
				uint32_t *state, pm_device_cb cb, void *arg)
{
	int ret = 0;
	struct spi_nrfx_data *data = get_dev_data(dev);
	const struct spi_nrfx_config *config = get_dev_config(dev);

	if (ctrl_command == PM_DEVICE_STATE_SET) {
		uint32_t new_state = *state;

		if (new_state != data->pm_state) {
			switch (new_state) {
			case PM_DEVICE_STATE_ACTIVE:
				ret = init_spim(dev);
				/* Force reconfiguration before next transfer */
				data->ctx.config = NULL;
				break;

			case PM_DEVICE_STATE_LOW_POWER:
			case PM_DEVICE_STATE_SUSPEND:
			case PM_DEVICE_STATE_OFF:
				if (data->pm_state == PM_DEVICE_STATE_ACTIVE)
					nrfx_spim_uninit(&config->spim);

				break;

			default:
				ret = -ENOTSUP;
			}

			if (!ret)
				data->pm_state = new_state;
		}
	} else {
		__ASSERT_NO_MSG(ctrl_command == PM_DEVICE_STATE_GET);
		*state = data->pm_state;
	}

	if (cb)
		cb(dev, ret, state, arg);

	return ret;
}
#endif /* CONFIG_PM_DEVICE */

/*
 * We use NODELABEL here because the nrfx API requires us to call
 * functions which are named according to SoC peripheral instance
 * being operated on. Since DT_INST() makes no guarantees about that,
 * it won't work.
 */
#define SPIM(idx) DT_NODELABEL(spi##idx)
#define SPIM_PROP(idx, prop) DT_PROP(SPIM(idx), prop)

#define SPIM_NRFX_MISO_PULL_DOWN(idx) DT_PROP(SPIM(idx), miso_pull_down)
#define SPIM_NRFX_MISO_PULL_UP(idx) DT_PROP(SPIM(idx), miso_pull_up)

#define SPIM_NRFX_MISO_PULL(idx)			\
	(SPIM_NRFX_MISO_PULL_UP(idx)			\
		? SPIM_NRFX_MISO_PULL_DOWN(idx)		\
			? -1 /* invalid configuration */\
			: NRF_GPIO_PIN_PULLUP		\
		: SPIM_NRFX_MISO_PULL_DOWN(idx)		\
			? NRF_GPIO_PIN_PULLDOWN		\
			: NRF_GPIO_PIN_NOPULL)

#define SPI_NRFX_SPIM_EXTENDED_CONFIG(idx)				\
	IF_ENABLED(NRFX_SPIM_EXTENDED_ENABLED,				\
		(.dcx_pin = NRFX_SPIM_PIN_NOT_USED,			\
		 IF_ENABLED(SPIM##idx##_FEATURE_RXDELAY_PRESENT,	\
			(.rx_delay = CONFIG_SPI_##idx##_NRF_RX_DELAY,))	\
		))

#define SPI_NRFX_SPIM_DEVICE(idx)					       \
	BUILD_ASSERT(						       \
		!SPIM_NRFX_MISO_PULL_UP(idx) || !SPIM_NRFX_MISO_PULL_DOWN(idx),\
		"SPIM"#idx						       \
		": cannot enable both pull-up and pull-down on MISO line");    \
	static int spi_##idx##_init(const struct device *dev)		       \
	{								       \
		IRQ_CONNECT(NRFX_IRQ_NUMBER_GET(NRF_SPIM##idx),		       \
			    DT_IRQ(SPIM(idx), priority),		       \
			    nrfx_isr, nrfx_spim_##idx##_irq_handler, 0);       \
		int err = init_spim(dev);				       \
		spi_context_unlock_unconditionally(&get_dev_data(dev)->ctx);   \
		return err;						       \
	}								       \
	static struct spi_nrfx_data spi_##idx##_data = {		       \
		SPI_CONTEXT_INIT_LOCK(spi_##idx##_data, ctx),		       \
		SPI_CONTEXT_INIT_SYNC(spi_##idx##_data, ctx),		       \
		.busy = false,						       \
	};								       \
	static const struct spi_nrfx_config spi_##idx##z_config = {	       \
		.spim = NRFX_SPIM_INSTANCE(idx),			       \
		.max_chunk_len = (1 << SPIM##idx##_EASYDMA_MAXCNT_SIZE) - 1,   \
		.max_freq = SPIM##idx##_MAX_DATARATE * 1000000,		       \
		.config = {						       \
                        .sck_pin   = SPIM_PROP(idx, sck_pin),                  \
                        .mosi_pin  = SPIM_PROP(idx, mosi_pin),                 \
                        .miso_pin  = SPIM_PROP(idx, miso_pin),                 \
			.ss_pin    = 0x2c,\
			.orc       = CONFIG_SPI_##idx##_NRF_ORC,	       \
			.frequency = NRF_SPIM_FREQ_4M,			       \
			.mode      = NRF_SPIM_MODE_0,			       \
			.bit_order = NRF_SPIM_BIT_ORDER_MSB_FIRST,	       \
			.miso_pull = SPIM_NRFX_MISO_PULL(idx),		       \
			SPI_NRFX_SPIM_EXTENDED_CONFIG(idx)		       \
		}							       \
	};								       \
	DEVICE_DT_DEFINE(SPIM(idx),					       \
		      spi_##idx##_init,					       \
		      spim_nrfx_pm_control,				       \
		      &spi_##idx##_data,				       \
		      &spi_##idx##z_config,				       \
		      POST_KERNEL, CONFIG_SPI_INIT_PRIORITY,		       \
		      &spi_nrfx_driver_api)

#ifdef CONFIG_SPI_0_NRF_SPIM
SPI_NRFX_SPIM_DEVICE(0);
#endif

#ifdef CONFIG_SPI_1_NRF_SPIM
SPI_NRFX_SPIM_DEVICE(1);
#endif

#ifdef CONFIG_SPI_2_NRF_SPIM
SPI_NRFX_SPIM_DEVICE(2);
#endif

#ifdef CONFIG_SPI_3_NRF_SPIM
SPI_NRFX_SPIM_DEVICE(3);
#endif

#ifdef CONFIG_SPI_4_NRF_SPIM
SPI_NRFX_SPIM_DEVICE(4);
#endif

const struct device *spim_perip_get(void)
{
	const struct device *spi_perip;

#ifdef CONFIG_BOARD_NRF52840DK_NRF52840
	spi_perip = device_get_binding("SPI_3");
#elif CONFIG_BOARD_NRF5340DK_NRF5340_CPUAPP
	spi_perip = device_get_binding("SPI_4");
#endif

	if (spi_perip == NULL) {
		printk("Could not get SPI device\n");
		return NULL;
	}

	printk("%p : got device\n", spi_perip);

	return spi_perip;
}

unsigned int spim_xfer_tx(const struct device *spi_perip, const struct spi_config *spi_cfg,
		unsigned int addr, const void *data, unsigned int len)
{
	int err;
	static uint8_t *tx_buffer;

	tx_buffer = (uint8_t *)(k_malloc(4+len));

	const struct spi_buf tx_buf = {
		.buf = tx_buffer,
		.len = 4 + len
	};
	const struct spi_buf_set tx = {
		.buffers = &tx_buf,
		.count = 1
	};

	/* PP opcode : 0x02 */
	tx_buffer[0] = 0x02;

	/* addr */
	tx_buffer[1] = (((addr >> 16) & 0xFF) | 0x80);
	tx_buffer[2] = (addr >> 8) & 0xFF;
	tx_buffer[3] = addr & 0xFF;

	/* data */
	memcpy(tx_buffer+4, data, len);

	err = spi_transceive(spi_perip, spi_cfg, &tx, NULL);

	k_free(tx_buffer);

	return err;
}

unsigned int spim_xfer_rx(const struct device *spi_perip, const struct spi_config *spi_cfg,
		unsigned int addr, void *data, unsigned int len)
{
	int err;
	int dummy = 5;
	uint8_t *tx_buffer = NULL;
	uint8_t *rx_buffer = NULL;

	tx_buffer = (uint8_t *)(k_malloc(dummy+len));

	if (tx_buffer == NULL) {
		printk("SPI error:NO MEMORY for tx_buffer\n");
		return -ENOMEM;
	}

	rx_buffer = (uint8_t *)(k_malloc(dummy+len));

	if (rx_buffer == NULL) {
		printk("SPI error:NO MEMORY rx_buffer\n");
		k_free(tx_buffer);
		return -ENOMEM;
	}

	memset(tx_buffer, 0, len+dummy);
	memset(rx_buffer, 0, len+dummy);

	const struct spi_buf tx_buf = {
		.buf = tx_buffer,
		.len = (len+dummy)
	};
	const struct spi_buf_set tx = {
		.buffers = &tx_buf,
		.count = 1
	};

	struct spi_buf rx_buf = {
		.buf = rx_buffer,
		.len =  (len+dummy),
	};
	const struct spi_buf_set rx = {
		.buffers = &rx_buf,
		.count = 1
	};

	/* FASTREAD opcode : 0x0b */

	tx_buffer[0] = 0x0b;
	tx_buffer[1] = (addr >> 16) & 0xFF;
	tx_buffer[2] = (addr >> 8) & 0xFF;
	tx_buffer[3] = addr & 0xFF;

	err = spi_transceive(spi_perip, spi_cfg, &tx, &rx);
	memcpy(data, rx_buffer+dummy, len);

	if (err)
		printk("SPI error: %d\n", err);

	k_free(tx_buffer);
	k_free(rx_buffer);

	return err;
}

unsigned int spim_wait_while_rpu_awake(const struct device *spi_perip, const struct spi_config *spi_cfg)
{
	int err, len;
	static uint8_t tx_buffer[6] = {0x1f};

	len = sizeof(tx_buffer);

	const struct spi_buf tx_buf = {
		.buf = tx_buffer,
		.len = len
	};
	const struct spi_buf_set tx = {
		.buffers = &tx_buf,
		.count = 1
	};

	uint8_t sr[6];

	struct spi_buf rx_buf = {
		.buf = &sr,
		.len = sizeof(sr),
	};
	const struct spi_buf_set rx = {
		.buffers = &rx_buf,
		.count = 1
	};

#if 0
	do {

		err = spi_transceive(spi_perip, spi_cfg, &tx, &rx);

		printk("%x %x %x %x %x %x\n", sr[0], sr[1], sr[2], sr[3], sr[4], sr[5]);

	} while ((err < 0) || ((sr[1] & RPU_AWAKE_BIT) == 0));

	if (err) {
		printk("SPI error: %d\n", err);
	} else {
		/* Connect MISO to MOSI for loopback */
		/* printk("TX sent: %x\n", tx_buffer[0]); */
	}
#else

	for (int ii = 0; ii<10; ii++) {

		err = spi_transceive(spi_perip, spi_cfg, &tx, &rx);

		printk("%x %x %x %x %x %x\n", sr[0], sr[1], sr[2], sr[3], sr[4], sr[5]);

	        if ((err < 0) || ((sr[1] & RPU_AWAKE_BIT) == 0)) {
			printk("ret val = 0x%x\t RDSR1 = 0x%x --- FAILED RPU Wakeup\n",err, sr[1]);
		} else {
			printk("ret val = 0x%x\t RDSR1 = 0x%x -- RPU Awake!!\n",err, sr[1]);
			break;
		}
                k_msleep(1);
	}
	 
#endif


	return 0;
}

/* Wait until RDSR2 confirms RPU_WAKE write is successful */
unsigned int spim_validate_rpu_awake(const struct device *spi_perip, const struct spi_config *spi_cfg)
{
	int err, len;
	static uint8_t tx_buffer[6] = {0x2f};

	len = sizeof(tx_buffer);

	const struct spi_buf tx_buf = {
		.buf = tx_buffer,
		.len = len
	};
	const struct spi_buf_set tx = {
		.buffers = &tx_buf,
		.count = 1
	};

	uint8_t sr[6];

	struct spi_buf rx_buf = {
		.buf = &sr,
		.len = sizeof(sr),
	};
	const struct spi_buf_set rx = {
		.buffers = &rx_buf,
		.count = 1
	};

	for (int ii = 0; ii<1; ii++) {

		err = spi_transceive(spi_perip, spi_cfg, &tx, &rx);

		printk("%x %x %x %x %x %x\n", sr[0], sr[1], sr[2], sr[3], sr[4], sr[5]);

	        if ((err < 0) || ((sr[1] & RPU_AWAKE_BIT) == 0)) {
			printk("RDSR2 = 0x%x\n",sr[1]);
		} else {
			printk("RDSR2 = 0x%x\n",sr[1]);
			break;
		}
                //k_msleep(1);
	}
	 
	return 0;
}

unsigned int spim_cmd_rpu_wakeup(const struct device *spi_perip, const struct spi_config *spi_cfg, uint32_t data)
{
	int err, len;
	static uint8_t tx_buffer[] = {0x3f, 0x1};

	tx_buffer[1] = data&0xff;

	/* printf("TODO : %s:\n", __func__); */

	len = sizeof(tx_buffer);

	const struct spi_buf tx_buf = {
		.buf = tx_buffer,
		.len = len
	};
	const struct spi_buf_set tx = {
		.buffers = &tx_buf,
		.count = 1
	};

	err = spi_transceive(spi_perip, spi_cfg, &tx, NULL);

	if (err) {
		printk("SPI error: %d\n", err);
	} else {
		/* Connect MISO to MOSI for loopback */
		/* printk("TX sent: %x\n", tx_buffer[0]); */
	}

	return 0;
}

unsigned int spim_cmd_sleep_rpu(const struct device *spi_perip, const struct spi_config *spi_cfg)
{
	int err, len;
	static uint8_t tx_buffer[] = {0x3f, 0x0};

	/* printf("TODO : %s:\n", __func__); */

	len = sizeof(tx_buffer);

	const struct spi_buf tx_buf = {
		.buf = tx_buffer,
		.len = len
	};
	const struct spi_buf_set tx = {
		.buffers = &tx_buf,
		.count = 1
	};

	err = spi_transceive(spi_perip, spi_cfg, &tx, NULL);

	if (err) {
		printk("SPI error: %d\n", err);
	} else {
		/* Connect MISO to MOSI for loopback */
		/* printk("TX sent: %x\n", tx_buffer[0]); */
	}

	return 0;
}
static const struct spi_config spi_cfg = {
	.operation = SPI_WORD_SET(8) | SPI_TRANSFER_MSB,
	.frequency = 8000000,
	.slave = 0,
};

const struct device *spim_perip;

int spim_init(struct qspi_config *config)
{
	spim_perip = spim_perip_get();

	spim_config = config;

#ifdef CONFIG_BOARD_NRF5340DK_NRF5340_CPUAPP
	/* SPIM4 (<32Mbps)  : 1Mbps -> 1Mhz */
	config->spimfreq = config->freq * 1000000;
#endif
#ifdef CONFIG_BOARD_NRF52840DK_NRF52840
	/* SPIM3 (<8Mbps): 1Mbps -> 1Mhz */
	config->spimfreq = config->freq * 1000000;
#endif

        printk("sck pin = 0x%08x \n",spi_4z_config.config.sck_pin);                  \
        printk("mosi pin = 0x%08x \n",spi_4z_config.config.mosi_pin);                  \
        printk("miso pin = 0x%08x \n",spi_4z_config.config.miso_pin);                  \
        printk("ss pin = 0x%08x \n",spi_4z_config.config.ss_pin);                  \

	k_sem_init(&spim_config->lock, 1, 1);
#if 0
	spim_cmd_rpu_wakeup(spim_perip, &spi_cfg);

	spim_wait_while_rpu_awake(spim_perip, &spi_cfg);
#endif
	return 0;
}


void spim_addr_check(unsigned int addr, const void *data, unsigned int len)
{
	if ((addr%4 != 0) || (((unsigned int)data)%4 != 0) || (len%4 != 0)) {
		printk("%s : Unaligned address %x %x %d %x %x\n",
				__func__, addr, (unsigned int)data,
				(addr%4 != 0),
				(((unsigned int)data)%4 != 0),
				(len%4 != 0)
			   );
	}
}

int spim_write(unsigned int addr, const void *data, int len)
{
	int status;

	spim_addr_check(addr, data, len);

	addr |= spim_config->addrmask;

	k_sem_take(&spim_config->lock, K_FOREVER);

	status = spim_xfer_tx(spim_perip, &spi_cfg, addr, data, len);

	k_sem_give(&spim_config->lock);

	return status;
}

int spim_read(unsigned int addr, void *data, int len)
{
	int status;

	spim_addr_check(addr, data, len);

	addr |= spim_config->addrmask;

	k_sem_take(&spim_config->lock, K_FOREVER);

	status = spim_xfer_rx(spim_perip, &spi_cfg, addr, data, len);

	k_sem_give(&spim_config->lock);

	return status;
}

int spim_hl_readw(unsigned int addr, void *data)
{
	uint8_t *rxb = NULL;
	int status = -1;
	int len = 4;

	len = len + (4 * spim_config->qspi_slave_latency);

	rxb = k_malloc(len);

	if (rxb == NULL) {
		printk("%s: ERROR ENOMEM line %d\n", __func__, __LINE__);
		return -ENOMEM;
	}
	memset(rxb, 0, len);

	k_sem_take(&spim_config->lock, K_FOREVER);

	status = spim_xfer_rx(spim_perip, &spi_cfg, addr, rxb, len);

	k_sem_give(&spim_config->lock);

	*(uint32_t *)data = *(uint32_t *)(rxb+(len-4));

	k_free(rxb);

	return status;
}

int spim_hl_read(unsigned int addr, void *data, int len)
{
	int count = 0;

	spim_addr_check(addr, data, len);

	while (count < (len/4)) {
		spim_hl_readw(addr + (4*count), (char *)data + (4*count));
		count++;
	}

	return 0;
}

//------------------------------added for wifi utils --------------------------------

void spim_cmd_rpu_wakeup_fn(const struct device *spi_perip, uint32_t data)
{
    spim_cmd_rpu_wakeup(spim_perip, &spi_cfg, data);
}

void spim_cmd_sleep_rpu_fn(const struct device *spi_perip) {

    spim_cmd_sleep_rpu(spim_perip, &spi_cfg);
}
	
void spim_wait_while_rpu_awake_fn(const struct device *spi_perip)
{
    spim_wait_while_rpu_awake(spim_perip, &spi_cfg);
}

void spim_validate_rpu_awake_fn(const struct device *spi_perip)
{
    spim_validate_rpu_awake(spim_perip, &spi_cfg);
}
```
